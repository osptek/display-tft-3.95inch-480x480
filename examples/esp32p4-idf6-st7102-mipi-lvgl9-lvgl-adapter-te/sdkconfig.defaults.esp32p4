## examples/esp32p4-idf6-st7102-mipi-lvgl9-lvgl-adapter-te/sdkconfig.defaults.esp32p4
```kconfig
# ESP32-P4 default configuration

CONFIG_IDF_TARGET="esp32p4"
CONFIG_BOOTLOADER_LOG_LEVEL_WARN=y
CONFIG_ESPTOOLPY_FLASHMODE_QIO=y
CONFIG_ESPTOOLPY_FLASHSIZE_16MB=y
CONFIG_ESPTOOLPY_FLASHFREQ_80M=y

# Default LCD interface: MIPI DSI
CONFIG_EXAMPLE_LCD_INTERFACE_MIPI_DSI=y

# PSRAM configuration
CONFIG_SPIRAM=y
CONFIG_SPIRAM_SPEED_250M=y
CONFIG_SPIRAM_XIP_FROM_PSRAM=y
CONFIG_SPIRAM_MEMTEST=n
CONFIG_CACHE_L2_CACHE_256KB=y
CONFIG_CACHE_L2_CACHE_LINE_128B=y

CONFIG_LV_COLOR_DEPTH_24=y
CONFIG_LV_DRAW_SW_DRAW_UNIT_CNT=2

CONFIG_IDF_EXPERIMENTAL_FEATURES=y
```
